## app/boards/shields/planck_like/Kconfig.defconfig
```kconfig
# Copyright (c) 2020 The ZMK Contributors
# SPDX-License-Identifier: MIT

if SHIELD_PLANCK_LIKE

config ZMK_KEYBOARD_NAME
    default "Planck-Like"

endif
```

## app/boards/shields/planck_like/Kconfig.shield
```kconfig
# Copyright (c) 2020 The ZMK Contributors
# SPDX-License-Identifier: MIT

config SHIELD_PLANCK_LIKE
	def_bool $(shields_list_contains,planck_like)
```

## app/boards/shields/reviung41/Kconfig.defconfig
```kconfig
 # Copyright (c) 2020 Xton
 # SPDX-License-Identifier: MIT

if SHIELD_REVIUNG41

config ZMK_KEYBOARD_NAME
    default "Reviung41"

# CONFIG_ZMK_BLE_CLEAR_BONDS_ON_START=y

endif
```

## app/boards/shields/reviung41/Kconfig.shield
```kconfig
# Copyright (c) 2020 Xton
# SPDX-License-Identifier: MIT
 
 config SHIELD_MY_BOARD
    def_bool $(shields_list_contains,reviung41)
```
